## sdkconfig.defaults
```kconfig
CONFIG_ESP_MAIN_TASK_STACK_SIZE=16384
CONFIG_FREERTOS_HZ=1000
CONFIG_FREERTOS_USE_TRACE_FACILITY=y
CONFIG_FREERTOS_GENERATE_RUN_TIME_STATS=y
CONFIG_FREERTOS_RUN_TIME_STATS_USING_ESP_TIMER=y
CONFIG_FREERTOS_VTASKLIST_INCLUDE_COREID=y
CONFIG_LWIP_MAX_SOCKETS=16
CONFIG_BT_ENABLED=y
CONFIG_BT_BLUEDROID_ENABLED=y
CONFIG_BT_BLE_ENABLED=y
CONFIG_BT_GATTC_ENABLE=y
CONFIG_BT_BLE_50_FEATURES_SUPPORTED=y
CONFIG_BT_BLE_42_FEATURES_SUPPORTED=n
CONFIG_NABTOOLS_GATT_CLIENT=y
CONFIG_NABTOOLS_SIG_COMMON=y
CONFIG_NABTOOLS_TPMS_STRUCT=y
CONFIG_NABTOOLS_TPMS_CBOR=n
CONFIG_NABTOOLS_SMARTTAG_STRUCT=n
CONFIG_NABTOOLS_SMARTTAG_CBOR=n
CONFIG_NABTOOLS_HRM_STRUCT=n
CONFIG_NABTOOLS_HRM_CBOR=n
CONFIG_NAWSERVER_BACKEND_TCP=y
CONFIG_NAWSERVER_BACKEND_HTTPD=n
CONFIG_NAWSERVER_WEBSOCKET=y
CONFIG_NAWSERVER_SSE=y
CONFIG_NAWSERVER_TCP_BUFFER_BYTES=131072
CONFIG_NAWSERVER_TCP_HTTP_STACK_SIZE=8192
CONFIG_LV_COLOR_DEPTH_UNSET=y
CONFIG_LV_COLOR_FORMAT_RGB565=y
CONFIG_LV_USE_BUILTIN_MALLOC=n
CONFIG_LV_USE_CLIB_MALLOC=y
CONFIG_LV_ASSERT_HANDLER_INCLUDE=""
CONFIG_LV_FONT_MONTSERRAT_20=y
CONFIG_LV_FONT_MONTSERRAT_14=y
CONFIG_LV_FONT_MONTSERRAT_28=y
CONFIG_LV_FONT_MONTSERRAT_24=y
CONFIG_LV_USE_XML=n
CONFIG_LV_USE_OBJ_PROPERTY=n
CONFIG_LV_USE_OBJ_PROPERTY_NAME=n

CONFIG_COMPILER_CXX_EXCEPTIONS=y
```
